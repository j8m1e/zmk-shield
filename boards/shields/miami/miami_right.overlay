/*
 * Copyright (c) 2020 The ZMK Contributors
 *
 * SPDX-License-Identifier: MIT
 */

#include "miami.dtsi"

&default_transform {
    col-offset = <7>;
};

/ {

    /* This kscan is for the 65% right half the 60% right half
     * may require different column and row pins
     */
    kscan0: kscan {
        compatible = "zmk,kscan-gpio-matrix";
        wakeup-source;

        diode-direction = "col2row";



        col-gpios
            = <&gpio0 29 GPIO_ACTIVE_HIGH>
            , <&gpio0 02 GPIO_ACTIVE_HIGH>
            , <&gpio1 15 GPIO_ACTIVE_HIGH>
            , <&gpio1 13 GPIO_ACTIVE_HIGH>
            , <&gpio1 11 GPIO_ACTIVE_HIGH>
            , <&gpio0 10 GPIO_ACTIVE_HIGH>
            , <&gpio0 09 GPIO_ACTIVE_HIGH>
            //, <&gpio1 06 GPIO_ACTIVE_HIGH>
            //, <&gpio1 04 GPIO_ACTIVE_HIGH>
            ;

        row-gpios
            = <&gpio0 31 (GPIO_ACTIVE_HIGH | GPIO_PULL_DOWN)>
            , <&gpio0 22 (GPIO_ACTIVE_HIGH | GPIO_PULL_DOWN)>
            , <&gpio0 24 (GPIO_ACTIVE_HIGH | GPIO_PULL_DOWN)>
            , <&gpio1 00 (GPIO_ACTIVE_HIGH | GPIO_PULL_DOWN)>
            , <&gpio0 11 (GPIO_ACTIVE_HIGH | GPIO_PULL_DOWN)>
            ;
    };
};


//&gpio0 17

//006 008 gnd gnd 017 020 022 024 100 011 104 106 b-
//gnd rgb
//raw gnd rst vcc 031 029 002 115 113 111 010 009 b+