## boards/shields/miami/Kconfig.defconfig
```kconfig
if SHIELD_MIAMI_LEFT

config ZMK_KEYBOARD_NAME
    default "Miami_left"

config ZMK_SPLIT_ROLE_CENTRAL
    default y

endif

if SHIELD_MIAMI_RIGHT

config ZMK_KEYBOARD_NAME
    default "Miami_right"

config ZMK_SPLIT_ROLE_CENTRAL
    default y

endif

if SHIELD_MIAMI_LEFT || SHIELD_MIAMI_RIGHT

config ZMK_SPLIT
    default y

endif
```

## boards/shields/miami/Kconfig.shield
```kconfig
config SHIELD_MIAMI_LEFT
    def_bool $(shields_list_contains,miami_left)

config SHIELD_MIAMI_RIGHT
    def_bool $(shields_list_contains,miami_right)
```
